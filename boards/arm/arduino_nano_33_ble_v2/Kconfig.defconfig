## boards/arm/arduino_nano_33_ble_v2/Kconfig.defconfig
```kconfig
# Copyright (c) 2020 Jefferson Lee.
# SPDX-License-Identifier: Apache-2.0

if BOARD_ARDUINO_NANO_33_BLE_V2 || BOARD_ARDUINO_NANO_33_BLE_SENSE_V2

config BOARD
	default "arduino_nano_33_ble_v2" if BOARD_ARDUINO_NANO_33_BLE_v2
	default "arduino_nano_33_ble_sense_v2" if BOARD_ARDUINO_NANO_33_BLE_SENSE_V2

config BT_CTLR
	default BT

config REGULATOR
	default y if SENSOR

endif # BOARD_ARDUINO_NANO_33_BLE_V2 || BOARD_ARDUINO_NANO_33_BLE_SENSE_V2
```

## boards/arm/skywalk_mobo/Kconfig.board
```kconfig
# STM32H743ZI Nucleo board configuration

# Copyright (c) 2020 Teslabs Engineering S.L.
# SPDX-License-Identifier: Apache-2.0

config BOARD_SKYWALK_MOBO
	bool "Skywalk Motherboard"
	depends on SOC_STM32H743XX
```

## west.yml
```yaml
# Copyright (c) 2021 Nordic Semiconductor ASA
# SPDX-License-Identifier: Apache-2.0

manifest:
  self:
    west-commands: scripts/west-commands.yml

  remotes:
    - name: zephyrproject-rtos
      url-base: https://github.com/zephyrproject-rtos
    - name: skywalk
      url-base: https://github.com/skywalk-software

  projects:
    - name: zephyr
      remote: skywalk
      revision: feature/lsm6dsl_lis3mdl
      import: true
```
